## luckfox-pico/sysdrv/tools/board/buildroot/luckfox_pico_defconfig
```kconfig
BR2_arm=y
BR2_cortex_a7=y
BR2_TOOLCHAIN_EXTERNAL=y
BR2_TOOLCHAIN_EXTERNAL_CUSTOM=y
BR2_TOOLCHAIN_EXTERNAL_PATH="../../../../tools/linux/toolchain/arm-rockchip830-linux-uclibcgnueabihf"
BR2_TOOLCHAIN_EXTERNAL_CUSTOM_PREFIX="arm-rockchip830-linux-uclibcgnueabihf"
BR2_TOOLCHAIN_EXTERNAL_GCC_8=y
BR2_TOOLCHAIN_EXTERNAL_HEADERS_5_10=y
BR2_TOOLCHAIN_EXTERNAL_WCHAR=y
BR2_TOOLCHAIN_EXTERNAL_HAS_SSP=y
BR2_TOOLCHAIN_EXTERNAL_CXX=y
BR2_PRIMARY_SITE="http://sources.buildroot.net"
BR2_OPTIMIZE_3=y
BR2_PACKAGE_BUSYBOX_SHOW_OTHERS=y
BR2_PACKAGE_E2FSPROGS_RESIZE2FS=y
BR2_PACKAGE_PYTHON3=n
BR2_PACKAGE_PYTHON3_SSL=n
BR2_PACKAGE_PYTHON_AIOHTTP=n
BR2_PACKAGE_PYTHON_CLICK=n
BR2_PACKAGE_PYTHON_ITSDANGEROUS=n
BR2_PACKAGE_PYTHON_JINJA2=n
BR2_PACKAGE_PYTHON_PERIPHERY=n
BR2_PACKAGE_PYTHON_PILLOW=n
BR2_PACKAGE_PYTHON_SERIAL=n
BR2_PACKAGE_PYTHON_SETUPTOOLS=n
BR2_PACKAGE_PYTHON_SMBUS_CFFI=n
BR2_PACKAGE_PYTHON_SPIDEV=n
BR2_PACKAGE_PYTHON_WERKZEUG=n
BR2_PACKAGE_DTC=y
BR2_PACKAGE_DTC_PROGRAMS=y
BR2_PACKAGE_LIBV4L=n
BR2_PACKAGE_LIBV4L_UTILS=n
BR2_PACKAGE_LRZSZ=y
BR2_PACKAGE_NTP=n
BR2_PACKAGE_OPENSSH=y
BR2_PACKAGE_SAMBA4=n
BR2_PACKAGE_BASH=n
BR2_PACKAGE_BASH_LOADABLE_EXAMPLES=n
BR2_PACKAGE_DIALOG=y
BR2_PACKAGE_TIME=y
BR2_PACKAGE_HTOP=y
BR2_PACKAGE_NANO=n
BR2_PACKAGE_HOST_DTC=y
```
